## examples/esp-box/firmware/Sdkconfig.defaults
```kconfig
CONFIG_BOOTLOADER_SKIP_VALIDATE_IN_DEEP_SLEEP=y
CONFIG_BOOTLOADER_WDT_ENABLE=n
CONFIG_BOOTLOADER_SKIP_VALIDATE_ON_POWER_ON=y
CONFIG_ESPTOOLPY_FLASHSIZE_16MB=y
CONFIG_ESPTOOLPY_FLASHSIZE="16MB"
```

## examples/esp-box/firmware/main/sdkconfig.defaults
```kconfig
CONFIG_ESP_SR_ENABLED=y
CONFIG_PARTITION_TABLE_CUSTOM=y
CONFIG_PARTITION_TABLE_FILENAME="partitions.csv"
CONFIG_ESP32_S3_BOX_BOARD=y
CONFIG_ESP_AUDIO_BOARD_CUSTOM=y
```
